## defconfig
```kconfig
CONFIG_AML_FULLMAC=m
CONFIG_AML_SOFTMAC=n
CONFIG_AML_FHOST=n
CONFIG_AML_SDM=n
CONFIG_AML_TL4=n
CONFIG_AML_OLD_IPC=n
CONFIG_AML_BCMC=y
CONFIG_AML_SPLIT_TX_BUF=y
CONFIG_AML_USB_LARGE_PAGE=y
CONFIG_AML_RECOVERY=y
CONFIG_AML_P2P_DEBUGFS=y
CONFIG_BUILDROOT=n
CONFIG_AML_FPGA_PCIE=n
CONFIG_AML_PLATFORM_ANDROID=y
CONFIG_AML_PLATFORM_RANDOM_MAC=n
CONFIG_AML_PREALLOC_BUF_STATIC=y
CONFIG_AML_PREALLOC_BUF_SKB=n
CONFIG_AML_WFA_CERT_MODE=n
CONFIG_AML_POWER_SAVE_MODE=n
CONFIG_AML_WOW_GOOGLE_CAST_EN=n
CONFIG_AML_WOW_MAGIC_PACKET_EN=n
CONFIG_AML_USE_TASK=y
CONFIG_AML_RX_MINISIZE=n
CONFIG_AML_NAPI=y
CONFIG_MDNS_OFFLOAD_FEATURE=y
CONFIG_CUSTOMER_11D_FORBIDDEN=y
CONFIG_SDIO_TX_ENH=n
CONFIG_ANDROID_GKI=y
CONFIG_AML_ANDROID="16"
CONFIG_AML_AMSDUS_TX=y
CONFIG_AML_BFMER=y
CONFIG_AML_SUSPEND=y
CONFIG_AML_RADAR=y
CONFIG_AML_MON_DATA=n
CONFIG_AML_RX_SG=n
CONFIG_AML_SW_PROFILING=n
CONFIG_AML_DBG=n
CONFIG_AML_LA=y
CONFIG_AML_CSA_MODE=y
CONFIG_SDIO_MODE_ON=y
CONFIG_AML_SDIO_IRQ_VIA_GPIO=y
CONFIG_AML_W2L_RX_MINISIZE=n
CONFIG_LIGHT_WEIGHT_MEM=y
CONFIG_AML_SDIO_USB_FW_REORDER=y
CONFIG_KERNEL_AX_PATCH=n
CONFIG_AML_MUMIMO_TX=n
CONFIG_AML_UM_HELPER_DFLT="/usr/bin/aml_umh.sh"
```
